/*
 * Reference devicetree definition for the driver.
 * Edit the mainline RMI4 driver node.
 * Properties marked "important" must be present.
 */

synaptics-rmi4-i2c@20 {
	compatible = "syna,rmi4-i2c";
	reg = <0x20>;
	#address-cells = <1>;
	#size-cells = <0>;
	interrupts-extended = <&tlmm 125 IRQ_TYPE_LEVEL_LOW>;

	pinctrl-names = "default";
	pinctrl-0 = <&ts_default_pins>;

	vdd-supply = <&ts_vdd_supply>;
	vio-supply = <&ts_vio_supply>;

	rmi4-f01@1 {
		reg = <0x01>;
		syna,nosleep-mode = <1>;
	};

	rmi4-f12@12 {
		reg = <0x12>;
		syna,clip-x-high = <1079>;
		syna,clip-y-high = <2159>;
		touchscreen-x-mm = <68>;
		touchscreen-y-mm = <144>;
		syna,sensor-type = <1>;
		syna,rezero-wait-ms = <200>;
	};
};
